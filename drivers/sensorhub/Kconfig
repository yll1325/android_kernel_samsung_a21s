## drivers/sensorhub/Kconfig
```kconfig
config SENSORS_ISG5320A
	depends on I2C
	tristate "ISG5320A grip"
	default n
	help
	  If you say yes here if you use ISG5320A for grip.
	  This option enables grip sensors using
	  IMAGIS ISG5320A device driver for grip.

config SENSORS_ISG5320A_SUB
	depends on I2C
	tristate "ISG5320A grip sub"
	default n
	help
	  If you say yes here if you use ISG5320A_SUB for grip sub.
	  This option enables grip sensors using
	  IMAGIS ISG5320A_SUB device driver for grip sub.

config SENSORS_SSP
	tristate "Sensors ssp"
	default n
	depends on SPI
	help
	  ssp driver for sensor hub.
          If you say yes here you get ssp support for
	  sensor hub.
	  To compile this driver as a module, choose M here: the
	  module will be called ssp.

config SSP_ENG_DEBUG
	tristate "sensor hub eng debug mode"
	default n
	help
	  If you want to use eng debug mode for sensor hub, it should be set.


config SENSORS_SSP_A21S
	tristate "Sensors ssp a21s"
	default n
	help
	  If you want to use sensor hub for a21s project, it should be set.
```
